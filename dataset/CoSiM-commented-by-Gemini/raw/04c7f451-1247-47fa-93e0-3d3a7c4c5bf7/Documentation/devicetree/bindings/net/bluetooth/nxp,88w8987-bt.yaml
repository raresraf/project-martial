## dataset/CoSiM-commented-by-Gemini/raw/04c7f451-1247-47fa-93e0-3d3a7c4c5bf7/Documentation/devicetree/bindings/net/bluetooth/nxp,88w8987-bt.yaml
```yaml
# SPDX-License-Identifier: (GPL-2.0 OR BSD-2-Clause)
%YAML 1.2
---
$id: http://devicetree.org/schemas/net/bluetooth/nxp,88w8987-bt.yaml#
$schema: http://devicetree.org/meta-schemas/core.yaml#

title: NXP Bluetooth chips

description: |
  This document specifies the devicetree binding for UART-attached NXP
  Bluetooth controllers, which are part of dual-radio Wi-Fi/Bluetooth combo
  chips. The binding defines the necessary properties for the kernel to
  correctly initialize the firmware, configure the UART communication parameters,
  and manage the power-saving wakeup mechanisms. The communication protocol
  is standard HCI (H4) over a 4-wire UART interface.

maintainers:
  - Neeraj Sanjay Kale <neeraj.sanjaykale@nxp.com>

allOf:
  - $ref: bluetooth-controller.yaml#

properties:
  compatible:
    description: Identifies the specific NXP Bluetooth chip model.
    enum:
      - nxp,88w8987-bt
      - nxp,88w8997-bt

  fw-init-baudrate:
    $ref: /schemas/types.yaml#/definitions/uint32
    default: 115200
    description:
      Specifies the UART baud rate to be used after the firmware has been
      successfully downloaded and the device is initialized. This rate is
      typically higher than the initial boot ROM baud rate and is dependent
      on the firmware's configuration.

  firmware-name:
    description: The filename of the firmware to be loaded into the device.
    maxItems: 1

  device-wakeup-gpios:
    maxItems: 1
    description:
      Defines the GPIO pin used by the host to wake up the Bluetooth chip.
      This corresponds to the BT_WAKE_IN pin on the NXP chipset and is a key
      component of the host-to-chip power-saving mechanism.

  nxp,wakein-pin:
    $ref: /schemas/types.yaml#/definitions/uint8
    description:
      Specifies the internal GPIO pin number on the NXP chipset that is
      configured as the BT_WAKE_IN signal.

  interrupts:
    maxItems: 1
    description:
      Specifies the interrupt line connected from the Bluetooth chip's
      BT_WAKE_OUT pin to the host. The host uses this interrupt, typically
      triggered on a falling edge, to wake up from a low-power state when the
      Bluetooth chip needs attention.

  interrupt-names:
    items:
      - const: wakeup

  wakeup-source:
    description:
      Indicates that this device can wake the system from suspend. This property
      is essential for enabling low-power modes where the host CPU can sleep
      while the Bluetooth controller remains active.
    true

  nxp,wakeout-pin:
    $ref: /schemas/types.yaml#/definitions/uint8
    description:
      Specifies the internal GPIO pin number on the NXP chipset that is
      configured as the BT_WAKE_OUT signal.

required:
  - compatible

unevaluatedProperties: false

examples:
  - |
    #include <dt-bindings/gpio/gpio.h>
    #include <dt-bindings/interrupt-controller/irq.h>
    serial {
        bluetooth {
            compatible = "nxp,88w8987-bt";
            fw-init-baudrate = <3000000>;
            firmware-name = "uartuart8987_bt_v0.bin";
            device-wakeup-gpios = <&gpio 11 GPIO_ACTIVE_HIGH>;
            nxp,wakein-pin = /bits/ 8 <18>;
            nxp,wakeout-pin = /bits/ 8 <19>;
            local-bd-address = [66 55 44 33 22 11];
            interrupt-parent = <&gpio>;
            interrupts = <8 IRQ_TYPE_EDGE_FALLING>;
            interrupt-names = "wakeup";
            wakeup-source;
        };
    };
```

## dataset/CoSiM-commented-by-Gemini/raw/05314305-b286-4c5b-a80e-5c46defa6a97/arch/mips/crypto/Kconfig
```kconfig
# SPDX-License-Identifier: GPL-2.0
#
# Kconfig for MIPS-specific hardware-accelerated cryptographic algorithms.
# This file defines configuration options for enabling cryptographic drivers
# that leverage specialized hardware instructions on MIPS-based CPUs,
# particularly the Cavium OCTEON family.
#

menu "Accelerated Cryptographic Algorithms for CPU (mips)"

#
# This option enables the hardware-accelerated implementation of the MD5
# message digest algorithm for Cavium OCTEON processors. It provides a
# significant performance improvement over the generic C implementation by
# using dedicated cryptographic instructions.
#
config CRYPTO_MD5_OCTEON
	tristate "Digests: MD5 (OCTEON)"
	depends on CPU_CAVIUM_OCTEON
	select CRYPTO_MD5
	select CRYPTO_HASH
	help
	  MD5 message digest algorithm (RFC1321).

	  This enables the hardware-accelerated implementation of MD5 for
	  Cavium OCTEON processors, utilizing the chip's crypto instructions
	  for improved performance.

#
# This option enables the hardware-accelerated implementation of the SHA-1
# secure hash algorithm for Cavium OCTEON processors.
#
config CRYPTO_SHA1_OCTEON
	tristate "Hash functions: SHA-1 (OCTEON)"
	depends on CPU_CAVIUM_OCTEON
	select CRYPTO_SHA1
	select CRYPTO_HASH
	help
	  SHA-1 secure hash algorithm (FIPS 180).

	  This enables the hardware-accelerated implementation of SHA-1 for
	  Cavium OCTEON processors.

#
# This option enables the hardware-accelerated implementation of the SHA-384
# and SHA-512 secure hash algorithms for Cavium OCTEON processors.
#
config CRYPTO_SHA512_OCTEON
	tristate "Hash functions: SHA-384 and SHA-512 (OCTEON)"
	depends on CPU_CAVIUM_OCTEON
	select CRYPTO_SHA512
	select CRYPTO_HASH
	help
	  SHA-384 and SHA-512 secure hash algorithms (FIPS 180).

	  This enables the hardware-accelerated implementation of SHA-384 and
	  SHA-512 for Cavium OCTEON processors, utilizing the chip's crypto
	  instructions where available.

endmenu
```

## dataset/CoSiM-commented-by-Gemini/raw/05314305-b286-4c5b-a80e-5c46defa6a97/arch/powerpc/configs/44x/akebono_defconfig
```kconfig
#
# Default kernel configuration for the AMCC Akebono evaluation board.
#
# This configuration file enables the essential drivers and core kernel
# features required to boot and operate a Linux system on the
# Akebono board, which is based on a PowerPC 47x-class processor.
#

# Enables support for the PowerPC 44x processor family.
CONFIG_44x=y
# Enables Symmetric Multi-Processing (SMP) support.
CONFIG_SMP=y
# Enables System V IPC for inter-process communication.
CONFIG_SYSVIPC=y
CONFIG_POSIX_MQUEUE=y
# Sets the kernel log buffer size to 16KB (2^14).
CONFIG_LOG_BUF_SHIFT=14
# Enables support for an initial RAM disk (initrd).
CONFIG_BLK_DEV_INITRD=y
CONFIG_EXPERT=y
# Includes all symbols in the kernel symbol table for debugging.
CONFIG_KALLSYMS_ALL=y
# CONFIG_SLUB_CPU_PARTIAL is not set
CONFIG_PROFILING=y
# Enables support for loadable kernel modules.
CONFIG_MODULES=y
CONFIG_MODULE_UNLOAD=y
# CONFIG_BLK_DEV_BSG is not set
# Enables support for the PowerPC 47x processor series.
CONFIG_PPC_47x=y
# CONFIG_EBONY is not set
# Enables specific board support for the Akebono platform.
CONFIG_AKEBONO=y
# Enables High Memory support (for systems with more than ~1GB RAM).
CONFIG_HIGHMEM=y
CONFIG_HZ_100=y
# Distributes interrupts to all available CPUs.
CONFIG_IRQ_ALL_CPUS=y
# CONFIG_COMPACTION is not set
# CONFIG_SUSPEND is not set

#
# Networking support
#
CONFIG_NET=y
CONFIG_NETDEVICES=y
CONFIG_PACKET=y
CONFIG_UNIX=y
CONFIG_INET=y
CONFIG_IP_PNP=y
CONFIG_IP_PNP_DHCP=y
CONFIG_IP_PNP_BOOTP=y
# CONFIG_IPV6 is not set
CONFIG_DEVTMPFS=y
CONFIG_DEVTMPFS_MOUNT=y
CONFIG_CONNECTOR=y

#
# Storage and Filesystem support
#
CONFIG_MTD=y
CONFIG_MTD_BLOCK=y
CONFIG_MTD_JEDECPROBE=y
CONFIG_MTD_CFI_AMDSTD=y
CONFIG_MTD_PHYSMAP_OF=y
CONFIG_BLK_DEV_RAM=y
CONFIG_BLK_DEV_RAM_SIZE=35000
# CONFIG_SCSI_PROC_FS is not set
CONFIG_BLK_DEV_SD=y
# CONFIG_SCSI_LOWLEVEL is not set
# Enables support for ATA/SATA disk drives.
CONFIG_ATA=y
# CONFIG_SATA_PMP is not set
CONFIG_SATA_AHCI_PLATFORM=y
# CONFIG_ATA_SFF is not set
# CONFIG_NET_VENDOR_3COM is not set
# CONFIG_NET_VENDOR_ADAPTEC is not set
# CONFIG_NET_VENDOR_ALTEON is not set
# CONFIG_NET_VENDOR_AMD is not set
# CONFIG_NET_VENDOR_ARC is not set
# CONFIG_NET_VENDOR_ATHEROS is not set
# CONFIG_NET_VENDOR_BROADCOM is not set
# CONFIG_NET_VENDOR_BROCADE is not set
# CONFIG_NET_VENDOR_CHELSIO is not set
# CONFIG_NET_VENDOR_CISCO is not set
# CONFIG_NET_VENDOR_DEC is not set
# CONFIG_NET_VENDOR_DLINK is not set
# CONFIG_NET_VENDOR_EMULEX is not set
# Enables the IBM EMAC Ethernet driver used on the Akebono board.
CONFIG_IBM_EMAC=y
# CONFIG_NET_VENDOR_MARVELL is not set
# CONFIG_NET_VENDOR_MELLANOX is not set
# CONFIG_NET_VENDOR_MICREL is not set
# CONFIG_NET_VENDOR_MYRI is not set
# CONFIG_NET_VENDOR_NATSEMI is not set
# CONFIG_NET_VENDOR_NVIDIA is not set
# CONFIG_NET_VENDOR_OKI is not set
# CONFIG_NET_VENDOR_QLOGIC is not set
# CONFIG_NET_VENDOR_REALTEK is not set
# CONFIG_NET_VENDOR_RDC is not set
# CONFIG_NET_VENDOR_SEEQ is not set
# CONFIG_NET_VENDOR_SILAN is not set
# CONFIG_NET_VENDOR_SIS is not set
# CONFIG_NET_VENDOR_SMSC is not set
# CONFIG_NET_VENDOR_STMICRO is not set
# CONFIG_NET_VENDOR_SUN is not set
# CONFIG_NET_VENDOR_TEHUTI is not set
# CONFIG_NET_VENDOR_TI is not set
# CONFIG_NET_VENDOR_VIA is not set
# CONFIG_NET_VENDOR_WIZNET is not set
# CONFIG_NET_VENDOR_XILINX is not set

#
# Input and Console support
#
# CONFIG_KEYBOARD_ATKBD is not set
# CONFIG_MOUSE_PS2 is not set
# CONFIG_SERIO is not set
# CONFIG_VT is not set
# Enables the generic 8250 serial port driver.
CONFIG_SERIAL_8250=y
# CONFIG_SERIAL_8250_DEPRECATED_OPTIONS is not set
# Enables the 8250 serial port as a system console.
CONFIG_SERIAL_8250_CONSOLE=y
CONFIG_SERIAL_8250_EXTENDED=y
CONFIG_SERIAL_8250_SHARE_IRQ=y
# Enables the OF (Open Firmware) platform device helper for serial ports.
CONFIG_SERIAL_OF_PLATFORM=y

#
# Other hardware support
#
# CONFIG_HW_RANDOM is not set
CONFIG_I2C_CHARDEV=y
# CONFIG_HWMON is not set
CONFIG_THERMAL=y
# CONFIG_USB_DEFAULT_PERSIST is not set
# Enables USB EHCI (USB 2.0) support.
CONFIG_USB_EHCI_HCD=y
# Enables USB OHCI (USB 1.1) support.
CONFIG_USB_OHCI_HCD=y
# CONFIG_USB_OHCI_HCD_PCI is not set
CONFIG_USB_STORAGE=y
# Enables MMC/SD/SDIO card support.
CONFIG_MMC=y
CONFIG_MMC_SDHCI=y
CONFIG_MMC_SDHCI_PLTFM=y
CONFIG_RTC_CLASS=y
CONFIG_RTC_DRV_M41T80=y

#
# Filesystems
#
CONFIG_EXT2_FS=y
CONFIG_EXT4_FS=y
CONFIG_EXT4_FS_POSIX_ACL=y
CONFIG_EXT4_FS_SECURITY=y
# CONFIG_DNOTIFY is not set
# CONFIG_INOTIFY_USER is not set
CONFIG_VFAT_FS=y
CONFIG_PROC_KCORE=y
CONFIG_TMPFS=y
CONFIG_CRAMFS=y
# CONFIG_NETWORK_FILESYSTEMS is not set
CONFIG_NLS_DEFAULT="n"
CONFIG_NLS_CODEPAGE_437=y
CONFIG_NLS_ISO8859_1=y

#
# Kernel hacking and debugging
#
CONFIG_DEBUG_INFO_DWARF_TOOLCHAIN_DEFAULT=y
# Enables the Magic SysRq key for debugging.
CONFIG_MAGIC_SYSRQ=y
CONFIG_DETECT_HUNG_TASK=y
# Enables the XMON in-kernel debugger.
CONFIG_XMON=y
CONFIG_XMON_DEFAULT=y
# Enables early debugging output for PowerPC kernels.
CONFIG_PPC_EARLY_DEBUG=y
CONFIG_PPC_EARLY_DEBUG_44x_PHYSLOW=0x00010000
CONFIG_PPC_EARLY_DEBUG_44x_PHYSHIGH=0x33f

#
# Cryptography
#
CONFIG_CRYPTO_PCBC=y
CONFIG_CRYPTO_MD5=y
# Enables the PowerPC-specific SHA1 implementation.
CONFIG_CRYPTO_SHA1_PPC=y
CONFIG_CRYPTO_DES=y
# CONFIG_CRYPTO_HW is not set
```

## dataset/CoSiM-commented-by-Gemini/raw/72a8413f-ccda-49b4-b601-314617442c54/Documentation/devicetree/bindings/spi/spi-sg2044-nor.yaml
```yaml
# SPDX-License-Identifier: (GPL-2.0-only OR BSD-2-Clause)
%YAML 1.2
---
$id: http://devicetree.org/schemas/spi/spi-sg2044-nor.yaml#
$schema: http://devicetree.org/meta-schemas/core.yaml#

title: Device Tree Bindings for Sophgo SG2044 SPI NOR Flash Memory Controller (FMC)

maintainers:
  - Longbin Li <looong.bin@gmail.com>

description: |
  This binding describes the SPI NOR Flash Memory Controller (FMC) found on
  Sophgo's SG2042 and SG2044 SoCs. The controller is used to interface with
  external SPI NOR flash memory devices. This binding defines the necessary
  properties for the kernel to properly configure and use the controller.

allOf:
  - $ref: spi-controller.yaml#

properties:
  compatible:
    description:
      Must be one of the specified compatible strings, identifying the specific
      SoC model. The driver uses this to match the device with the appropriate
      driver implementation.
    enum:
      - sophgo,sg2042-spifmc-nor
      - sophgo,sg2044-spifmc-nor

  reg:
    description:
      Specifies the base physical address and size of the memory-mapped
      registers for the SPI NOR controller.
    maxItems: 1

  clocks:
    description:
      A phandle to the clock that provides the functional clock for the SPI
      controller. The driver will use this to enable and manage the clock
      rate.
    maxItems: 1

  interrupts:
    description:
      Specifies the interrupt generated by the controller to signal completion
      of an operation or an error condition.
    maxItems: 1

  resets:
    description:
      A phandle to the reset controller that can be used to reset the SPI
      controller hardware block.
    maxItems: 1

required:
  - compatible
  - reg
  - clocks
  - interrupts
  - resets

unevaluatedProperties: false

examples:
  - |
    // This example demonstrates a typical device tree node for the SG2044
    // SPI NOR Flash Memory Controller.
    #include <dt-bindings/interrupt-controller/irq.h>

    // The node is typically a child of the main system bus.
    spi@1000000 {
      // "compatible" string identifies the specific hardware.
      compatible = "sophgo,sg2044-spifmc-nor";

      // "reg" specifies the controller's register map address and size.
      reg = <0x1000000 0x4000000>;

      // Standard SPI bus properties.
      #address-cells = <1>;
      #size-cells = <0>;

      // "clocks" points to the clock source for this controller.
      clocks = <&clk 0>;

      // "interrupts" defines the interrupt line and its trigger type.
      interrupts = <37 IRQ_TYPE_LEVEL_HIGH>;

      // "resets" points to the reset line for this controller.
      resets = <&rst 0>;
    };
```
