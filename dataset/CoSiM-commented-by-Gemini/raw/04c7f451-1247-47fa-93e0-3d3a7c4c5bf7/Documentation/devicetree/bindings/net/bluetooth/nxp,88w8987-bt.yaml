## dataset/CoSiM-commented-by-Gemini/raw/91d033a2-d16c-4f27-9057-01933fc556ca/Documentation/devicetree/bindings/interrupt-controller/fsl,icoll.yaml
```yaml
# SPDX-License-Identifier: (GPL-2.0-only OR BSD-2-Clause)
%YAML 1.2
---
#
# @file fsl,icoll.yaml
# @brief Device Tree Binding for the Freescale i.MX23/i.MX28 Interrupt Collector (ICOLL)
# @details This document specifies the device tree properties required to describe the ICOLL
#          interrupt controller found on Freescale/NXP i.MX23 and i.MX28 SoCs. The ICOLL
#          aggregates interrupt sources and presents them to the primary CPU interrupt controller.
#
$id: http://devicetree.org/schemas/interrupt-controller/fsl,icoll.yaml#
$schema: http://devicetree.org/meta-schemas/core.yaml#

title: Freescale MXS icoll Interrupt controller

maintainers:
  - Frank Li <Frank.Li@nxp.com>

# Defines the properties that can be used to describe an ICOLL device node.
properties:
  # The 'compatible' property is a string that identifies the specific device.
  # The kernel uses this to match the device node with the correct driver.
  compatible:
    oneOf:
      - items:
          - enum:
              - fsl,imx23-icoll # Specific compatible for i.MX23
              - fsl,imx28-icoll # Specific compatible for i.MX28
          - const: fsl,icoll # A more generic compatible, used as a fallback.

  # The 'reg' property specifies the physical memory address and size of the device's register block.
  reg:
    maxItems: 1

  # This property indicates that the device node represents an interrupt controller.
  interrupt-controller: true

  # This property defines the number of cells required to specify an interrupt.
  # For this controller, a single cell (the interrupt number) is sufficient.
  '#interrupt-cells':
    const: 1

# Specifies the list of properties that are mandatory for a valid device node.
required:
  - compatible
  - reg
  - interrupt-controller
  - '#interrupt-cells'

# Disallows any properties not explicitly defined in this schema.
additionalProperties: false

# Provides an example of a valid ICOLL device node declaration.
examples:
  - |
    # This example shows an ICOLL node for an i.MX28 SoC.
    interrupt-controller@80000000 {
        # The compatible string identifies the device as an i.MX28 ICOLL, with a fallback.
        compatible = "fsl,imx28-icoll", "fsl,icoll";
        # The register block is located at physical address 0x80000000 and is 0x2000 bytes in size.
        reg = <0x80000000 0x2000>;
        # Marks this node as an interrupt controller.
        interrupt-controller;
        # Specifies that one cell is needed to define an interrupt from this controller.
        #interrupt-cells = <1>;
    };
```

## dataset/CoSiM-commented-by-flash-Gemini/04c7f451-1247-47fa-93e0-3d3a7c4c5bf7/Documentation/devicetree/bindings/net/bluetooth/nxp,88w8987-bt.yaml
```yaml
#
# @brief Device Tree binding for NXP 88W8987/88W8997 Bluetooth chips.
# This YAML document describes the hardware characteristics and configuration
# required for integrating NXP's dual-radio (Wi-Fi and Bluetooth) chips,
# specifically the 88W8987 and 88W8997 models, into a Linux system via Device Tree.
# It details UART communication, firmware download procedures, and power save mechanisms.
#
# Domain: Device Tree, Bluetooth, NXP Hardware, Linux Kernel.
#
# SPDX-License-Identifier: (GPL-2.0 OR BSD-2-Clause)
%YAML 1.2
---
$id: http://devicetree.org/schemas/net/bluetooth/nxp,88w8987-bt.yaml#
$schema: http://devicetree.org/meta-schemas/core.yaml#

title: NXP Bluetooth chips

# Functional Utility: Provides a high-level overview of the binding's purpose.
# Describes how UART-attached NXP Bluetooth chips operate, including dual-radio
# capabilities, H4 protocol usage, firmware download via RTS/CTS, and the
# UART-TX break signal for power save mode.
description:
  This binding describes UART-attached NXP bluetooth chips. These chips
  are dual-radio chips supporting WiFi and Bluetooth. The bluetooth
  works on standard H4 protocol over 4-wire UART. The RTS and CTS lines
  are used during FW download. To enable power save mode, the host
  asserts break signal over UART-TX line to put the chip into power save
  state. De-asserting break wakes up the BT chip.

# Functional Utility: Lists the contact person(s) responsible for maintaining this binding.
maintainers:
  - Neeraj Sanjay Kale <neeraj.sanjaykale@nxp.com>

# Block Logic: Inherits definitions from a common Bluetooth controller schema.
# This ensures adherence to standard Bluetooth controller properties and conventions.
allOf:
  - $ref: bluetooth-controller.yaml#

# Block Logic: Defines the hardware-specific properties for the NXP Bluetooth chip.
# These properties are used by the kernel to configure and interact with the device.
properties:
  compatible:
    enum:
      - nxp,88w8987-bt
      - nxp,88w8997-bt

  fw-init-baudrate:
    $ref: /schemas/types.yaml#/definitions/uint32
    default: 115200
    description:
      Chip baudrate after FW is downloaded and initialized.
      This property depends on the module vendor's
      configuration.

  firmware-name:
    maxItems: 1

  device-wakeup-gpios:
    maxItems: 1
    description:
      Host-To-Chip power save mechanism is driven by this GPIO
      connected to BT_WAKE_IN pin of the NXP chipset.

  nxp,wakein-pin:
    $ref: /schemas/types.yaml#/definitions/uint8
    description:
      The GPIO number of the NXP chipset used for BT_WAKE_IN.

  interrupts:
    maxItems: 1
    description:
      Host wakeup by falling edge interrupt on this pin which is
      connected to BT_WAKE_OUT pin of the NXP chipset.

  interrupt-names:
    items:
      - const: wakeup

  wakeup-source: true

  nxp,wakeout-pin:
    $ref: /schemas/types.yaml#/definitions/uint8
    description:
      The GPIO number of the NXP chipset used for BT_WAKE_OUT.

# Block Logic: Specifies the mandatory properties that must be present in the device tree node.
# The 'compatible' property is critical for the kernel to identify and bind the correct driver.
required:
  - compatible

# Functional Utility: Disallows any properties not explicitly defined in this schema.
# This helps prevent accidental misconfigurations and ensures strict adherence to the binding.
unevaluatedProperties: false

# Block Logic: Provides an illustrative example of a device tree node for this NXP Bluetooth chip.
# This example demonstrates the correct syntax and usage of all relevant properties for hardware integration.
examples:
  - |
    #include <dt-bindings/gpio/gpio.h>
    #include <dt-bindings/interrupt-controller/irq.h>
    serial {
        bluetooth {
            compatible = "nxp,88w8987-bt";
            fw-init-baudrate = <3000000>;
            firmware-name = "uartuart8987_bt_v0.bin";
            device-wakeup-gpios = <&gpio 11 GPIO_ACTIVE_HIGH>;
            nxp,wakein-pin = /bits/ 8 <18>;
            nxp,wakeout-pin = /bits/ 8 <19>;
            local-bd-address = [66 55 44 33 22 11];
            interrupt-parent = <&gpio>;
            interrupts = <8 IRQ_TYPE_EDGE_FALLING>;
            interrupt-names = "wakeup";
            wakeup-source;
        };
    };
```

## dataset/CoSiM-commented-by-flash-Gemini/05314305-b286-4c5b-a80e-5c46defa6a97/arch/mips/crypto/Kconfig
```kconfig
#
# @brief Kconfig file for MIPS architecture-specific cryptographic algorithms.
# This file defines the kernel configuration options for accelerated cryptographic
# algorithms, such as MD5, SHA-1, and SHA-512, specifically optimized for the
# Cavium OCTEON processors within the MIPS architecture. It enables selective
# inclusion of these algorithms based on hardware support.
#
# Domain: Linux Kernel, Kconfig, MIPS Architecture, Cryptography.
#
# SPDX-License-Identifier: GPL-2.0

menu "Accelerated Cryptographic Algorithms for CPU (mips)"
# Block Logic: Configuration entry for MD5 cryptographic algorithm on OCTEON.
# Enables the selection of MD5 message digest algorithm, dependent on the
# presence of Cavium OCTEON CPU. It automatically selects the generic
# CRYPTO_MD5 and CRYPTO_HASH options.
config CRYPTO_MD5_OCTEON
	tristate "Digests: MD5 (OCTEON)"
	depends on CPU_CAVIUM_OCTEON
	select CRYPTO_MD5
	select CRYPTO_HASH
	help
	  MD5 message digest algorithm (RFC1321)

	  Architecture: mips OCTEON using crypto instructions, when available

# Block Logic: Configuration entry for SHA-1 cryptographic algorithm on OCTEON.
# Enables the selection of SHA-1 secure hash algorithm, dependent on the
# presence of Cavium OCTEON CPU. It automatically selects the generic
# CRYPTO_SHA1 and CRYPTO_HASH options.
config CRYPTO_SHA1_OCTEON
	tristate "Hash functions: SHA-1 (OCTEON)"
	depends on CPU_CAVIUM_OCTEON
	select CRYPTO_SHA1
	select CRYPTO_HASH
	help
	  SHA-1 secure hash algorithm (FIPS 180)

	  Architecture: mips OCTEON

# Block Logic: Configuration entry for SHA-384 and SHA-512 algorithms on OCTEON.
# Enables the selection of SHA-384 and SHA-512 secure hash algorithms,
# dependent on the presence of Cavium OCTEON CPU. It automatically selects
# the generic CRYPTO_SHA512 and CRYPTO_HASH options.
config CRYPTO_SHA512_OCTEON
	tristate "Hash functions: SHA-384 and SHA-512 (OCTEON)"
	depends on CPU_CAVIUM_OCTEON
	select CRYPTO_SHA512
	select CRYPTO_HASH
	help
	  SHA-384 and SHA-512 secure hash algorithms (FIPS 180)

	  Architecture: mips OCTEON using crypto instructions, when available

endmenu
```
